## soc/snps/nsim/arc_v/rmx/Kconfig.defconfig
```kconfig
# Copyright (c) 2024 Synopsys, Inc.
# SPDX-License-Identifier: Apache-2.0

if SOC_SERIES_RMX

config RISCV_SOC_INTERRUPT_INIT
	default y

config MULTI_LEVEL_INTERRUPTS
	default n

config NUM_IRQS
	default 18

config RISCV_SPMP
	default y

config SPMP_SLOTS
	default 16

endif # SOC_SERIES_RMX
```
